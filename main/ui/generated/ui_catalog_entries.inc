UI_CATALOG("繁體中文", "繁体中文", "Traditional Chinese", "中国語"),
UI_CATALOG("簡體中文", "简体中文", "Simplified Chinese", "簡体字中国語"),
UI_CATALOG("英文", "英文", "English", "英語"),
UI_CATALOG("晴朗", "晴朗", "Clear", "晴れ"),
UI_CATALOG("多雲", "多云", "P.cldy", "曇り"),
UI_CATALOG("陰", "阴", "Cloudy", "曇り"),
UI_CATALOG("霧", "雾", "Fog", "もや"),
UI_CATALOG("毛毛雨", "毛毛雨", "Drizzle", "小雨"),
UI_CATALOG("下雨", "下雨", "Rain", "雨"),
UI_CATALOG("下雪", "下雪", "Snow", "雪"),
UI_CATALOG("雷雨", "雷雨", "Storm", "強い雨"),
UI_CATALOG("未知", "未知", "Unk.", "不明"),
UI_CATALOG("有雨雪，出門記得帶傘。", "有雨雪，出门记得带伞。", "Rain/snow expected. Take an umbrella.", "雨や雪の予報です。かさをお持ちください。"),
UI_CATALOG("天氣寒冷，請注意保暖與路面結冰。", "天气寒冷，请注意保暖与路面结冰。", "Cold weather. Dress warmly; watch for ice.", "寒い日です。暖かくして凍結に注意してください。"),
UI_CATALOG("天氣晴朗，戶外活動請注意防曬。", "天气晴朗，户外活动请注意防晒。", "Clear skies. Use sun protection.", "晴れた日です。日光に注意してください。"),
UI_CATALOG("能見度較低，行車請減速並保持距離。", "能见度较低，行车请减速并保持距离。", "Low visibility. Drive carefully.", "視界が悪いため運転に注意してください。"),
UI_CATALOG("天氣資料不足，請留意最新資訊。", "天气数据不足，请留意最新信息。", "Weather data incomplete. Check updates.", "天気データが不足しています。最新情報を確認してください。"),
UI_CATALOG("星期日", "星期日", "Sunday", "日曜日"),
UI_CATALOG("星期一", "星期一", "Monday", "月曜日"),
UI_CATALOG("星期二", "星期二", "Tuesday", "火曜日"),
UI_CATALOG("星期三", "星期三", "Wednesday", "水曜日"),
UI_CATALOG("星期四", "星期四", "Thursday", "木曜日"),
UI_CATALOG("星期五", "星期五", "Friday", "金曜日"),
UI_CATALOG("星期六", "星期六", "Saturday", "土曜日"),
UI_CATALOG("優", "优", "Excellent", "優"),
UI_CATALOG("良", "良", "Good", "良"),
UI_CATALOG("敏感不健康", "敏感不健康", "Sens.", "注意"),
UI_CATALOG("不健康", "不健康", "Unhealthy", "不健康"),
UI_CATALOG("非常不健康", "非常不健康", "Very bad", "非常に不健康"),
UI_CATALOG("危害", "危害", "Hazardous", "危ない"),
UI_CATALOG("北", "北", "N", "北"),
UI_CATALOG("東北", "东北", "NE", "北東"),
UI_CATALOG("東", "东", "E", "東"),
UI_CATALOG("東南", "东南", "SE", "南東"),
UI_CATALOG("南", "南", "S", "南"),
UI_CATALOG("西南", "西南", "SW", "南西"),
UI_CATALOG("西", "西", "W", "西"),
UI_CATALOG("西北", "西北", "NW", "北西"),
UI_CATALOG("校時", "校时", "Time", "時刻"),
UI_CATALOG("聲音", "声音", "Sound", "サウンド"),
UI_CATALOG("顯示", "显示", "Display", "表示"),
UI_CATALOG("系統", "系统", "System", "システム"),
UI_CATALOG("語言", "语言", "Language", "言語"),
UI_CATALOG("檢查更新", "检查更新", "Check for updates", "更新を確認"),
UI_CATALOG("網路檢測", "网络检测", "Network diagnostics", "ネットワーク確認"),
UI_CATALOG("同步時間", "同步时间", "Sync time", "時刻を同期"),
UI_CATALOG("同步天氣", "同步天气", "Sync weather", "天気を同期"),
UI_CATALOG("更新一言", "更新一言", "Update saying", "一言を更新"),
UI_CATALOG("天氣城市", "天气城市", "Weather city", "天気の都市"),
UI_CATALOG("音量", "音量", "Volume", "音量"),
UI_CATALOG("頁面順序", "页面顺序", "Page order", "ページ並び"),
UI_CATALOG("鬧鐘", "闹钟", "Alarm", "アラーム"),
UI_CATALOG("關於本機", "关于本机", "About", "情報"),
UI_CATALOG("清除配對", "清除配对", "Clear pairing", "ペアリングを解除"),
UI_CATALOG("設定模式", "设置模式", "Setup", "設定モード"),
UI_CATALOG("離線模式", "离线模式", "Offline", "オフライン"),
UI_CATALOG("恢復原廠", "恢复出厂", "Factory reset", "初期化"),
UI_CATALOG("目標語言已儲存", "目标语言已保存", "Target language saved", "対象言語を保存しました"),
UI_CATALOG("儲存失敗", "保存失败", "Save failed", "保存失敗"),
UI_CATALOG("正在檢查更新", "正在检查更新", "Checking update", "更新を確認中"),
UI_CATALOG("已是最新版本", "已是最新版本", "Already latest", "最新です"),
UI_CATALOG("下載中，請等待", "下载中，请等待", "Downloading, please wait", "ダウンロード中、お待ちください"),
UI_CATALOG("BOOT安裝更新", "BOOT安装更新", "Install update", "更新をインストール"),
UI_CATALOG("即將重新啟動", "即将重启", "Restarting soon", "まもなく再起動"),
UI_CATALOG("下載失敗", "下载失败", "Download failed", "ダウンロード失敗"),
UI_CATALOG("驗證失敗", "验证失败", "Verification failed", "確認失敗"),
UI_CATALOG("更新失敗", "更新失败", "Update failed", "更新失敗"),
UI_CATALOG("等待資料", "等待数据", "Waiting for data", "データを待機中"),
UI_CATALOG("同步中", "同步中", "Syncing", "同期中"),
UI_CATALOG("檢測中", "检测中", "Checking", "確認中"),
UI_CATALOG("沒有 Wi-Fi", "没有 Wi-Fi", "No Wi-Fi", "Wi-Fiなし"),
UI_CATALOG("小智準備中", "小智准备中", "Xiaozhi preparing", "Xiaozhi準備中"),
UI_CATALOG("綁定 ID: ", "绑定 ID: ", "Binding ID: ", "バインドID: "),
UI_CATALOG("等待喚醒詞", "等待唤醒词", "Waiting for wake word", "ウェイクワードを待機中"),
UI_CATALOG("正在聆聽", "正在聆听", "Listening", "聞き取り中"),
UI_CATALOG("正在對話", "正在对话", "In conversation", "会話中"),
UI_CATALOG("小智服務無法使用", "小智服务不可用", "Xiaozhi unavailable", "Xiaozhiを利用できません"),
UI_CATALOG("農曆月份 %d", "农历月份 %d", "Lunar month %d", "月%d"),
UI_CATALOG("農曆第 %d 天", "农历第 %d 天", "Lunar day %d", "日%d"),
UI_CATALOG("閏", "闰", "Leap ", "うるう"),
UI_CATALOG("元旦", "元旦", "New Year's Day", "元日"),
UI_CATALOG("情人節", "情人节", "Valentine's Day", "バレンタインデー"),
UI_CATALOG("婦女節", "妇女节", "Women's Day", "国際女性デー"),
UI_CATALOG("勞動節", "劳动节", "Labour Day", "労働節"),
UI_CATALOG("兒童節", "儿童节", "Children's Day", "こどもの日"),
UI_CATALOG("教師節", "教师节", "Teachers' Day", "教師の日"),
UI_CATALOG("國慶", "国庆", "National Day", "建国記念日"),
UI_CATALOG("聖誕", "圣诞", "Christmas", "クリスマス"),
UI_CATALOG("春節", "春节", "Spring Festival", "春祭り"),
UI_CATALOG("元宵", "元宵", "Lantern Festival", "小正月"),
UI_CATALOG("端午", "端午", "Dragon Boat Festival", "端午節"),
UI_CATALOG("七夕", "七夕", "Qixi Festival", "七夕"),
UI_CATALOG("中秋", "中秋", "Mid-Autumn Festival", "中秋節"),
UI_CATALOG("重陽", "重阳", "Double Ninth Festival", "重陽の節句"),
UI_CATALOG("臘八", "腊八", "Laba Festival", "臘八節"),
UI_CATALOG("小寒", "小寒", "Minor Cold", "小寒"),
UI_CATALOG("大寒", "大寒", "Major Cold", "大寒"),
UI_CATALOG("立春", "立春", "Start of Spring", "立春"),
UI_CATALOG("雨水", "雨水", "Rain Water", "雨水"),
UI_CATALOG("驚蟄", "惊蛰", "Awakening of Insects", "啓蟄"),
UI_CATALOG("春分", "春分", "Spring Equinox", "春分"),
UI_CATALOG("清明", "清明", "Pure Brightness", "清明"),
UI_CATALOG("穀雨", "谷雨", "Grain Rain", "穀雨"),
UI_CATALOG("立夏", "立夏", "Start of Summer", "立夏"),
UI_CATALOG("小滿", "小满", "Grain Full", "小満"),
UI_CATALOG("芒種", "芒种", "Grain in Ear", "芒種"),
UI_CATALOG("夏至", "夏至", "Summer Solstice", "夏至"),
UI_CATALOG("小暑", "小暑", "Minor Heat", "小暑"),
UI_CATALOG("大暑", "大暑", "Major Heat", "大暑"),
UI_CATALOG("立秋", "立秋", "Start of Autumn", "立秋"),
UI_CATALOG("處暑", "处暑", "End of Heat", "処暑"),
UI_CATALOG("白露", "白露", "White Dew", "白露"),
UI_CATALOG("秋分", "秋分", "Autumn Equinox", "秋分"),
UI_CATALOG("寒露", "寒露", "Cold Dew", "寒露"),
UI_CATALOG("霜降", "霜降", "Frost Descent", "霜降"),
UI_CATALOG("立冬", "立冬", "Start of Winter", "立冬"),
UI_CATALOG("小雪", "小雪", "Minor Snow", "小雪"),
UI_CATALOG("大雪", "大雪", "Major Snow", "大雪"),
UI_CATALOG("冬至", "冬至", "Winter Solstice", "冬至"),
UI_CATALOG("日出", "日出", "Sunrise", "日の出"),
UI_CATALOG("日落", "日落", "Sunset", "日没"),
UI_CATALOG("溼度", "湿度", "Humidity", "水分"),
UI_CATALOG("風", "风", "Wind", "風"),
UI_CATALOG("空氣品質", "空气质量", "AQI", "大気質"),
UI_CATALOG("附近的 Wi-Fi", "附近的 Wi-Fi", "Nearby Wi-Fi", "近くのWi-Fi"),
UI_CATALOG("重新掃描", "重新扫描", "Scan again", "再スキャン"),
UI_CATALOG("網路連線成功", "网络连接成功", "Wi-Fi connected", "Wi-Fi接続完了"),
UI_CATALOG("正在連線 Wi-Fi", "正在连接 Wi-Fi", "Connecting to Wi-Fi", "Wi-Fi接続中"),
UI_CATALOG("Wi-Fi 連線失敗", "Wi-Fi 连接失败", "Wi-Fi connection failed", "Wi-Fi接続失敗"),
UI_CATALOG("設定資訊不完整", "配置信息不完整", "Setup information incomplete", "設定情報が不足しています"),
UI_CATALOG("Codex", "Codex", "Codex", "Codex"),
UI_CATALOG("日文", "日语", "Japanese", "日本語"),
UI_CATALOG("語言 %s", "语言 %s", "Language %s", "言語 %s"),
UI_CATALOG("天氣城市 %s", "天气城市 %s", "Weather city %s", "天気の都市 %s"),
UI_CATALOG("天氣城市 自動", "天气城市 自动", "Weather city Auto", "天気の都市 自動"),
UI_CATALOG("音量 靜音", "音量 静音", "Muted", "ミュート"),
UI_CATALOG("音量 %d%%", "音量 %d%%", "Vol %d%%", "音量 %d%%"),
UI_CATALOG("聲音選擇 %d", "声音选择 %d", "Sound %d", "音声 %d"),
UI_CATALOG("聲音 %d", "声音 %d", "Sound %d", "音声 %d"),
UI_CATALOG("整點提醒 7:00 - 22:00", "整点提醒 7:00 - 22:00", "Hourly 7-22", "毎時 7:00 - 22:00"),
UI_CATALOG("全天提醒 0:00 - 24:00", "全天提醒 0:00 - 24:00", "All-day 0-24", "終日 0:00 - 24:00"),
UI_CATALOG("頁面開關", "页面开关", "Page mode", "ページ切替"),
UI_CATALOG("鬧鐘 %02d:%02d", "闹钟 %02d:%02d", "Alarm %02d:%02d", "アラーム %02d:%02d"),
UI_CATALOG("鬧鐘 --:--", "闹钟 --:--", "Alarm --:--", "アラーム --:--"),
UI_CATALOG("自動返回", "自动返回", "Auto return", "自動戻り"),
UI_CATALOG("自訂圖 %s", "自定义图 %s", "Custom %s", "カスタム %s"),
UI_CATALOG("離線模式 %s", "离线模式 %s", "Offline %s", "オフライン %s"),
UI_CATALOG("開", "开", "On", "オン"),
UI_CATALOG("關", "关", "Off", "オフ"),
UI_CATALOG("確認恢復", "确认恢复", "Confirm reset", "初期化を確認"),
UI_CATALOG("請由設定網頁或小智修改", "请由设置网页或小智修改", "Change this from the setup page or Xiaozhi", "設定ページまたはXiaozhiで変更"),
UI_CATALOG("目前處於離線模式", "目前处于离线模式", "Currently offline", "現在オフライン"),
UI_CATALOG("請先完成線上設定", "请先完成在线设置", "Complete online setup first", "オンライン設定を先に完了"),
UI_CATALOG("%s%s", "%s%s", "%s: %s", "%s: %s"),
UI_CATALOG("已開啟", "已开启", "Enabled", "ON"),
UI_CATALOG("已關閉", "已关闭", "Disabled", "OFF"),
UI_CATALOG("Codex 配對已清除", "Codex 配对已清除", "Codex pairing cleared", "Codexペアリング解除済み"),
UI_CATALOG("清除 Codex 配對失敗", "清除 Codex 配对失败", "Failed to clear Codex pairing", "Codexペアリング解除失敗"),
UI_CATALOG("藍牙配對", "蓝牙配对", "BLUETOOTH PAIRING", "Bluetoothペアリング"),
UI_CATALOG("請在 Windows 輸入此代碼", "请在 Windows 输入此代码", "Enter this code in Windows", "Windowsにコードを入力"),
UI_CATALOG("需要安全連線", "需要安全连接", "Secure connection required", "安全な接続が必要"),
UI_CATALOG("%lu天 %lu小時", "%lu天 %lu小时", "%lud %luh", "%lu日 %lu時間"),
UI_CATALOG("%lu小時 %lu分", "%lu小时 %lu分", "%luh %lum", "%lu時間 %lu分"),
UI_CATALOG("%lu分", "%lu分", "%lum", "%lu分"),
UI_CATALOG("CODEX 剩餘 (%s)", "CODEX 剩余 (%s)", "CODEX LEFT (%s)", "CODEX残り (%s)"),
UI_CATALOG("重設於 %s", "重置 %s", "RESET %s", "%sにリセット"),
UI_CATALOG("重設於 --", "重置 --", "RESET --", "--にリセット"),
UI_CATALOG("CODEX 剩餘 (--)", "CODEX 剩余 (--)", "CODEX LEFT (--)", "CODEX残り (--)"),
UI_CATALOG("付費額度", "付费额度", "PAID CREDITS", "有料"),
UI_CATALOG("今日", "今日", "TODAY", "今日"),
UI_CATALOG("7 天", "7 天", "7 DAYS", "7日"),
UI_CATALOG("正在執行", "线程", "RUN", "実行"),
UI_CATALOG("重設額度", "重置额度", "RESET CR", "CR 残り"),
UI_CATALOG("額度到期", "额度到期", "CR EXP", "CR 期限"),
UI_CATALOG("藍牙已關閉", "蓝牙关闭", "BLUETOOTH OFF", "Bluetoothオフ"),
UI_CATALOG("(離線)", "(离线)", "(OFFLINE)", "(オフライン)"),
UI_CATALOG("無限", "无限", "UNLIM", "無制限"),
UI_CATALOG("番茄鐘", "番茄钟", "POMODORO", "ポモドーロ"),
UI_CATALOG("專注中", "专注中", "FOCUS", "集中中"),
UI_CATALOG("已完成", "已完成", "DONE", "完了"),
UI_CATALOG("分 / 秒", "分 / 秒", "MIN / SEC", "分 / s"),
UI_CATALOG("頁面順序已儲存", "页面顺序已保存", "Page order saved", "ページ並びを保存しました"),
UI_CATALOG("請等待同步完成", "请等待同步完成", "Please wait for sync to finish", "同期完了を待ってください"),
UI_CATALOG("離線模式已開啟", "离线模式已开启", "Offline mode enabled", "オフライン ON"),
UI_CATALOG("離線模式已關閉", "离线模式已关闭", "Offline mode disabled", "オフライン OFF"),
UI_CATALOG("正在同步時間...", "正在同步时间...", "Syncing time...", "時刻を同期中..."),
UI_CATALOG("正在同步天氣...", "正在同步天气...", "Syncing weather...", "天気を同期中..."),
UI_CATALOG("正在更新一言...", "正在更新一言...", "Updating saying...", "一言を更新中..."),
UI_CATALOG("正在網路檢測...", "正在网络检测...", "Running network diagnostics...", "ネットワーク確認中..."),
UI_CATALOG("已靜音", "已静音", "Muted", "ミュート"),
UI_CATALOG("整點提醒已開啟", "整点提醒已开启", "Hourly reminder enabled", "毎時通知 ON"),
UI_CATALOG("整點提醒已關閉", "整点提醒已关闭", "Hourly reminder disabled", "毎時通知 OFF"),
UI_CATALOG("全天提醒已開啟", "全天提醒已开启", "All-day reminder enabled", "終日通知 ON"),
UI_CATALOG("全天提醒已關閉", "全天提醒已关闭", "All-day reminder disabled", "終日通知 OFF"),
UI_CATALOG("BOOT交換並儲存", "BOOT交换并保存", "Swap with BOOT and save", "BOOTで交換して保存"),
UI_CATALOG("頁面開關：BOOT切換", "页面开关：BOOT切换", "Page mode: switch with BOOT", "ページ切替: BOOT"),
UI_CATALOG("至少保留一個頁面", "至少保留一个页面", "Keep at least one page", "1ページ以上必要"),
UI_CATALOG("請至少保留一個非小智頁面", "请至少保留一个非小智页面", "Keep at least one non-Xiaozhi page", "Xiaozhi以外のページが必要"),
UI_CATALOG("小智 AI 不能設為主頁", "小智AI不能设为主页", "Xiaozhi cannot be the home page", "Xiaozhiをホームにできません"),
UI_CATALOG("請先取消番茄鐘", "请先取消番茄钟", "Stop Pomodoro first", "ポモドーロを先に解除"),
UI_CATALOG("小智自動返回已開啟", "小智自动返回已开启", "Xiaozhi auto return enabled", "Xiaozhi自動戻り ON"),
UI_CATALOG("小智自動返回已關閉", "小智自动返回已关闭", "Xiaozhi auto return disabled", "Xiaozhi自動戻り OFF"),
UI_CATALOG("預設圖片固定 24h", "默认图片固定 24h", "Built-in image fixed for 24h", "内蔵画像は24h"),
UI_CATALOG("鬧鐘已關閉", "闹钟已关闭", "Alarm disabled", "アラーム OFF"),
UI_CATALOG("請透過小智 AI 設定", "请通过小智AI设置", "Set this through Xiaozhi", "Xiaozhiで設定"),
UI_CATALOG("配網啟動失敗", "配网启动失败", "Setup portal failed to start", "ネット設定失敗"),
UI_CATALOG("再次按 BOOT 確認", "再次按 BOOT 确认", "Press BOOT again to confirm", "BOOTを再度押して確認"),
UI_CATALOG("恢復失敗", "恢复失败", "Factory reset failed", "復元失敗"),
UI_CATALOG("新版本 --", "新版本 --", "New version --", "Version --"),
UI_CATALOG("新版本 %s", "新版本 %s", "New version %s", "Version %s"),
UI_CATALOG("OTA --", "OTA --", "OTA --", "OTA --"),
UI_CATALOG("正在安裝 %d%%  %d KB/s", "正在安装 %d%%  %d KB/s", "OTA %d%%  %d KB/s", "OTA %d%%  %d KB/s"),
UI_CATALOG("正在安裝 %d%%", "正在安装 %d%%", "OTA %d%%", "OTA %d%%"),
UI_CATALOG("下載中，請等待", "下载中，请等待", "Downloading, please wait", "ダウンロード中、お待ちください"),
UI_CATALOG("BOOT安裝更新", "BOOT安装更新", "Install update", "更新をインストール"),
UI_CATALOG("正在檢查，請等待", "正在检查，请等待", "Checking, please wait", "更新を確認中"),
UI_CATALOG("即將重啟", "即将重启", "Restarting soon", "まもなく再起動"),
UI_CATALOG("BOOT重新檢查", "BOOT重新检查", "Check again with BOOT", "BOOT再確認"),
UI_CATALOG("BOOT開始檢查", "BOOT开始检查", "Start check with BOOT", "BOOT確認"),
UI_CATALOG("等待更多天氣資料", "等待更多天气数据", "Waiting for more weather data", "天気データを待機中"),
UI_CATALOG("%d日", "%d日", "%d", "%d日"),
UI_CATALOG("今日 --/--°C", "今日 --/--°C", "Today --/--°C", "今日 --/--°C"),
UI_CATALOG("今日 %s/%s°C", "今日 %s/%s°C", "Today %s/%s°C", "今日 %s/%s°C"),
UI_CATALOG("AQI --", "AQI --", "AQI --", "AQI --"),
UI_CATALOG("AQI %s %s", "AQI %s %s", "AQI %s %s", "AQI %s %s"),
UI_CATALOG("溼度 --%", "湿度 --%", "Hum --%", "Humi --%"),
UI_CATALOG("溼度 %s%%", "湿度 %s%%", "Hum %s%%", "Humi %s%%"),
UI_CATALOG("-- --級", "-- --级", "-- level --", "-- --"),
UI_CATALOG("%s %s級", "%s %s级", "%s level %s", "%s %s"),
UI_CATALOG("日出 --:--", "日出 --:--", "Sunrise --:--", "出 --:--"),
UI_CATALOG("日出 %s", "日出 %s", "Sunrise %s", "出 %s"),
UI_CATALOG("日落 --:--", "日落 --:--", "Sunset --:--", "入 --:--"),
UI_CATALOG("日落 %s", "日落 %s", "Sunset %s", "入 %s"),
UI_CATALOG("距日落 --:--", "距日落 --:--", "Until sunset --:--", "入まで --:--"),
UI_CATALOG("距%s %02d:%02d", "距%s %02d:%02d", "Until %s %02d:%02d", "%sまで %02d:%02d"),
UI_CATALOG("準備完成", "准备完成", "Ready", "準備完了"),
UI_CATALOG("啟動時鐘", "启动时钟", "Starting clock", "時計を起動中"),
UI_CATALOG("RLCD 天氣時鐘", "RLCD 天气时钟", "RLCD Weather Clock", "RLCD 天気時計"),
UI_CATALOG("啟動中...", "启动中...", "Starting...", "起動中..."),
UI_CATALOG("準備系統", "准备系统", "Preparing system", "システムを準備中"),
UI_CATALOG("啟動時鐘", "启动时钟", "Starting clock", "時計を起動中"),
UI_CATALOG("電源鎖定不可用", "电源锁定不可用", "Power lock unavailable", "電源ロックを利用できません"),
UI_CATALOG("同步時間中", "同步时间中", "Synchronizing time", "時刻を同期中"),
UI_CATALOG("頁面資料已排程", "页面数据已排程", "Page data queued", "ページデータを予約済み"),
UI_CATALOG("啟動後重新整理中", "启动后刷新中", "Refreshing after startup", "起動後に更新中"),
UI_CATALOG("設定 AP: --", "设置 AP: --", "Setup AP: --", "AP設定: --"),
UI_CATALOG("設定 AP: %s", "设置 AP: %s", "Setup AP: %s", "AP設定: %s"),
UI_CATALOG("離線模式", "离线模式", "Offline mode", "オフライン"),
UI_CATALOG("設定模式", "设置模式", "Settings mode", "設定モード"),
UI_CATALOG("連線 Wi-Fi", "连接 Wi-Fi", "Connecting Wi-Fi", "Wi-Fi接続中"),
UI_CATALOG("Wi-Fi 啟動失敗", "Wi-Fi 启动失败", "Wi-Fi start failed", "Wi-Fi起動失敗"),
UI_CATALOG("Wi-Fi 連線逾時", "Wi-Fi 连接超时", "Wi-Fi timeout", "Wi-Fi接続タイムアウト"),
UI_CATALOG("請檢查 SSID 或密碼", "请检查 SSID 或密码", "Check SSID or password", "SSIDまたはパスワードを確認"),
UI_CATALOG("Wi-Fi 已連線", "Wi-Fi 已连接", "Wi-Fi connected", "Wi-Fi接続済み"),
UI_CATALOG("檢查時間", "检查时间", "Checking time", "時刻を確認中"),
UI_CATALOG("還原遺失的 RTC 時間", "恢复丢失的 RTC 时间", "Restoring lost RTC time", "失われたRTC時刻を復元中"),
UI_CATALOG("時間已同步", "时间已同步", "Time synchronized", "時刻同期済み"),
UI_CATALOG("稍後重試 NTP", "稍后重试 NTP", "NTP retry later", "NTPは後で再試行"),
UI_CATALOG("將在背景重試", "将在后台重试", "Will retry in background", "背景で再試行"),
UI_CATALOG("快速檢查 NTP", "快速检查 NTP", "Short NTP check", "短時間NTP確認"),
UI_CATALOG("等待", "等待", "Waiting", "待機中"),
UI_CATALOG("逾時/失敗", "超时/失败", "Timeout/failed", "タイムアウト/失敗"),
UI_CATALOG("成功", "成功", "OK", "成功"),
UI_CATALOG("電量低，已略過", "电量低，已跳过", "Battery low", "低電力のためスキップ"),
UI_CATALOG("本機IP: --", "本地IP: --", "Local IP: --", "ローカルIP: --"),
UI_CATALOG("公網IP: --", "公网IP: --", "Public IP: --", "パブリックIP: --"),
UI_CATALOG("IP定位: 未檢測", "IP定位: 未检测", "IP loc: unchecked", "IP位置情報: 未確認"),
UI_CATALOG("DNS: 未檢測", "DNS: 未检测", "DNS: unchecked", "DNS: 未確認"),
UI_CATALOG("天氣: 未檢測", "天气: 未检测", "Weather: n/a", "天気: 未確認"),
UI_CATALOG("NTP: 未檢測", "NTP: 未检测", "NTP: unchecked", "NTP: 未確認"),
UI_CATALOG("一言: 未檢測", "一言: 未检测", "Saying: n/a", "一言: 未確認"),
UI_CATALOG("公網: 未檢測", "公网: 未检测", "Net: n/a", "ネット: 未確認"),
UI_CATALOG("OTA來源: 未檢測", "OTA源: 未检测", "OTA: n/a", "OTA: 未確認"),
UI_CATALOG("本機IP: %s", "本地IP: %s", "Local IP: %s", "ローカルIP: %s"),
UI_CATALOG("公網IP: %s", "公网IP: %s", "Public IP: %s", "パブリックIP: %s"),
UI_CATALOG("IP定位: %s", "IP定位: %s", "IP loc: %s", "IP位置情報: %s"),
UI_CATALOG("IP定位: %s %s", "IP定位: %s %s", "IP loc: %s %s", "IP位置情報: %s %s"),
UI_CATALOG("DNS: %s", "DNS: %s", "DNS: %s", "DNS: %s"),
UI_CATALOG("天氣: %s", "天气: %s", "Weather: %s", "天気: %s"),
UI_CATALOG("NTP: %s", "NTP: %s", "NTP: %s", "NTP: %s"),
UI_CATALOG("一言: %s", "一言: %s", "Saying: %s", "一言: %s"),
UI_CATALOG("公網: %s", "公网: %s", "Net: %s", "ネット: %s"),
UI_CATALOG("OTA來源: %s", "OTA源: %s", "OTA: %s", "OTA: %s"),
UI_CATALOG("離線模式已開啟", "离线模式已开启", "Offline mode enabled", "オフラインモードを有効化"),
UI_CATALOG("IP定位: WiFi未設定", "IP定位: WiFi未配置", "IP loc: Wi-Fi off", "IP位置情報: Wi-Fi未設定"),
UI_CATALOG("IP定位: WiFi啟動失敗", "IP定位: WiFi启动失败", "IP loc: Wi-Fi start fail", "IP位置情報: Wi-Fi起動失敗"),
UI_CATALOG("IP定位: 系統繁忙", "IP定位: 系统繁忙", "IP loc: System busy", "IP位置情報: システムビジー"),
UI_CATALOG("IP定位: WiFi連線逾時", "IP定位: WiFi连接超时", "IP loc: Wi-Fi timeout", "IP位置情報: Wi-Fi接続タイムアウト"),
UI_CATALOG("準備檢測...", "准备检测...", "Ready to check...", "診断の準備中..."),
UI_CATALOG("檢測中...", "检测中...", "Checking...", "確認中..."),
UI_CATALOG("檢測完成", "检测完成", "Check complete", "確認完了"),
UI_CATALOG("等待開始", "等待开始", "Waiting to start", "開始待ち"),
UI_CATALOG("長按 KEY 返回", "长按 KEY 返回", "Hold KEY to return", "KEY長押しで戻る"),
UI_CATALOG("檢測中... 長按 KEY 返回", "检测中... 长按 KEY 返回", "Checking... Hold KEY to return", "確認中... KEY長押しで戻る"),
UI_CATALOG("系統資訊", "系统信息", "SYSTEM INFO", "システム情報"),
UI_CATALOG("上次 NTP: %s", "上次 NTP: %s", "Last NTP: %s", "前回のNTP: %s"),
UI_CATALOG("Wi-Fi: %s", "Wi-Fi: %s", "Wi-Fi: %s", "Wi-Fi: %s"),
UI_CATALOG("上次天氣: %s", "上次天气: %s", "Last weather: %s", "前回の天気: %s"),
UI_CATALOG("電量: %d%%  %.2fV \\ %s", "电量: %d%%  %.2fV \\ %s", "Battery: %d%%  %.2fV \\ %s", "バッテリー: %d%%  %.2fV \\ %s"),
UI_CATALOG("電量: %d%%  -- \\ %s", "电量: %d%%  -- \\ %s", "Battery: %d%%  -- \\ %s", "バッテリー: %d%%  -- \\ %s"),
UI_CATALOG("電量: --  -- \\ --", "电量: --  -- \\ --", "Battery: --  -- \\ --", "バッテリー: --  -- \\ --"),
UI_CATALOG("版本: %s / %s", "版本: %s / %s", "Version: %s / %s", "バージョン: %s / %s"),
UI_CATALOG("來源: %s", "来源: %s", "Source: %s", "ソース: %s"),
UI_CATALOG("設定模式", "设置模式", "Setup Mode", "設定モード"),
UI_CATALOG("AP SSID: --", "AP SSID: --", "AP SSID: --", "AP SSID: --"),
UI_CATALOG("AP 密碼: --", "AP 密码: --", "AP Password: --", "APパスワード: --"),
UI_CATALOG("入口 IP: --", "门户 IP: --", "Portal IP: --", "ポータルIP: --"),
UI_CATALOG("STA SSID: --", "STA SSID: --", "STA SSID: --", "STA SSID: --"),
UI_CATALOG("STA IP: --", "STA IP: --", "STA IP: --", "STA IP: --"),
UI_CATALOG("AP SSID: %s", "AP SSID: %s", "AP SSID: %s", "AP SSID: %s"),
UI_CATALOG("AP 密碼: %s", "AP 密码: %s", "AP Password: %s", "APパスワード: %s"),
UI_CATALOG("入口 IP: %s", "门户 IP: %s", "Portal IP: %s", "ポータルIP: %s"),
UI_CATALOG("STA SSID: %s", "STA SSID: %s", "STA SSID: %s", "STA SSID: %s"),
UI_CATALOG("STA IP: %s", "STA IP: %s", "STA IP: %s", "STA IP: %s"),
UI_CATALOG("STA IP: --  原因 %d", "STA IP: --  原因 %d", "STA IP: --  reason %d", "STA IP: --  原因 %d"),
UI_CATALOG("日", "日", "Sun", "日"),
UI_CATALOG("一", "一", "Mon", "月"),
UI_CATALOG("二", "二", "Tue", "火"),
UI_CATALOG("三", "三", "Wed", "水"),
UI_CATALOG("四", "四", "Thu", "木"),
UI_CATALOG("五", "五", "Fri", "金"),
UI_CATALOG("六", "六", "Sat", "土"),
UI_CATALOG("檢查更新", "检查更新", "Check OTA", "更新"),
UI_CATALOG("網路檢測", "网络检测", "Net test", "ネット確認"),
UI_CATALOG("同步時間", "同步时间", "Time sync", "時刻同期"),
UI_CATALOG("同步天氣", "同步天气", "Weather", "天気同期"),
UI_CATALOG("更新一言", "更新一言", "Saying", "一言更新"),
UI_CATALOG("天氣城市", "天气城市", "City", "天気都市"),
UI_CATALOG("頁面順序", "页面顺序", "Order", "ページ並び"),
UI_CATALOG("清除配對", "清除配对", "Clear pair", "ペア解除"),
UI_CATALOG("設定模式", "设置模式", "Setup", "設定"),
UI_CATALOG("恢復原廠", "恢复出厂", "Reset", "初期化"),
UI_CATALOG("確認恢復", "确认恢复", "Confirm reset", "初期化?"),
UI_CATALOG("頁面開關", "页面开关", "Pages", "ページ"),
UI_CATALOG("自動返回", "自动返回", "Auto", "自動"),
UI_CATALOG("語言 %s", "语言 %s", "%s", "言語 %s"),
UI_CATALOG("天氣城市 %s", "天气城市 %s", "City %s", "天気 %s"),
UI_CATALOG("天氣城市 自動", "天气城市 自动", "City Auto", "天気 自動"),
UI_CATALOG("整點提醒 7:00 - 22:00", "整点提醒 7:00 - 22:00", "Hourly 7-22", "毎時 7-22"),
UI_CATALOG("全天提醒 0:00 - 24:00", "全天提醒 0:00 - 24:00", "All-day 0-24", "終日 0-24"),
UI_CATALOG("鬧鐘 %02d:%02d", "闹钟 %02d:%02d", "Alarm %02d:%02d", "時刻 %02d:%02d"),
UI_CATALOG("鬧鐘 --:--", "闹钟 --:--", "Alarm --:--", "時刻 --:--"),
UI_CATALOG("自訂圖 %s", "自定义图 %s", "Image %s", "画像 %s"),
UI_CATALOG("離線模式 %s", "离线模式 %s", "Offline %s", "オフ %s"),
UI_CATALOG("設定", "设置", "Settings", "設定"),
UI_CATALOG("KEY選擇  長按返回  BOOT確認", "KEY选择  长按返回  BOOT确认", "KEY Select  Hold Return  BOOT Confirm", "KEY選  長押し戻る  BOOT確認"),
UI_CATALOG("天氣時鐘", "天气时钟", "WX-Clock", "天気時計"),
UI_CATALOG("圖片時鐘", "图片时钟", "Picture", "ピクチャー時計"),
UI_CATALOG("天氣看板", "天气看板", "Weather", "天気ボード"),
UI_CATALOG("溫溼時鐘", "温湿时钟", "T&H-Clock", "温湿度時計"),
UI_CATALOG("日曆", "日历", "Calendar", "カレンダー"),
UI_CATALOG("溫溼歷史", "温湿历史", "T&H-His", "温湿度履歴"),
UI_CATALOG("小智AI", "小智AI", "Xiaozhi AI", "Xiaozhi AI"),
UI_CATALOG("未知頁面", "未知页面", "Unknown page", "未知のページ"),
UI_CATALOG("----/--/--  星期-", "----/--/--  星期-", "----/--/--  ---", "----/--/--  ---"),
UI_CATALOG("溫度", "温度", "Temp", "温度"),
UI_CATALOG("溼度", "湿度", "Humi", "湿度"),
UI_CATALOG("等待資料", "等待数据", "Waiting", "待機中"),
UI_CATALOG("同步中", "同步中", "Syncing", "同期中"),
UI_CATALOG("設定 Wi-Fi", "设置 Wi-Fi", "Set Wi-Fi", "Wi-Fi設定"),
UI_CATALOG("檢查失敗", "检查失败", "Check failed", "確認失敗"),
UI_CATALOG("更新完成，正在重新啟動...", "更新完成，正在重新启动...", "Update complete, restarting...", "更新完了、再起動中..."),
UI_CATALOG("電量不足", "电量不足", "Battery too low", "バッテリー不足"),
UI_CATALOG("Wi-Fi 失敗", "Wi-Fi 失败", "Wi-Fi failed", "Wi-Fi失敗"),
UI_CATALOG("沒有 OTA 分區", "没有 OTA 分区", "No OTA partition", "OTAパーティションなし"),
UI_CATALOG("記憶體不足", "内存不足", "Out of memory", "メモリ不足"),
UI_CATALOG("更新不可用", "更新不可用", "Update unavailable", "更新を利用できません"),
UI_CATALOG("BOOT：檢查更新", "BOOT：检查更新", "BOOT: check for updates", "BOOT：更新を確認"),
UI_CATALOG("正在安裝更新 0%", "正在安装更新 0%", "Installing update 0%", "更新をインストール中 0%"),
UI_CATALOG("正在安裝備份 0%", "正在安装备份 0%", "Installing backup 0%", "バックアップをインストール中 0%"),
UI_CATALOG("正在安裝 %d%%  %dKB/s", "正在安装 %d%%  %dKB/s", "Installing %d%%  %dKB/s", "インストール中 %d%%  %dKB/s"),
UI_CATALOG("新版本 %s", "新版本 %s", "New version %s", "新バージョン %s"),
UI_CATALOG("OTA 狀態錯誤", "OTA 状态错误", "OTA status error", "OTA状態エラー"),
UI_CATALOG("天氣同步中", "天气同步中", "Sync weather", "天気を同期中"),
UI_CATALOG("請設定 Wi-Fi", "请设置 Wi-Fi", "Set Wi-Fi", "Wi-Fiを設定してください"),
UI_CATALOG("正在連接Wi-Fi", "正在连接Wi-Fi", "Connecting to Wi-Fi", "Wi-Fiに接続中"),
UI_CATALOG("請先在系統設定中配置 Wi-Fi", "请先在系统设置中配置 Wi-Fi", "Configure Wi-Fi in system settings first", "システム設定で先にWi-Fiを設定してください"),
UI_CATALOG("離線模式下無法使用小智 AI", "离线模式下无法使用小智 AI", "Xiaozhi AI is unavailable offline", "オフラインモードではXiaozhi AIを利用できません"),
UI_CATALOG("說出喚醒詞即可開始對話", "说出唤醒词即可开始对话", "Say the wake word to start a conversation", "ウェイクワードを言うと会話を開始できます"),
UI_CATALOG("語音監聽初始化失敗，請稍後重試", "语音监听初始化失败，请稍后重试", "Voice listener initialization failed. Try again later.", "音声リスナーの初期化に失敗しました。後でもう一度お試しください"),
UI_CATALOG("正在請求設備綁定資訊", "正在请求设备绑定信息", "Requesting device binding information", "デバイスのバインド情報を要求中"),
UI_CATALOG("小智記憶體不足，請稍後重試", "小智内存不足，请稍后重试", "Xiaozhi is out of memory. Try again later.", "Xiaozhiのメモリが不足しています。後でもう一度お試しください"),
UI_CATALOG("正在連接小智服務", "正在连接小智服务", "Connecting to Xiaozhi service", "Xiaozhiサービスに接続中"),
UI_CATALOG("請綁定設備", "请绑定设备", "Bind your device", "デバイスをバインドしてください"),
UI_CATALOG("稍後將自動重試", "稍后将自动重试", "Retrying later", "後で自動的に再試行します"),
UI_CATALOG("請在小智服務中輸入綁定 ID", "请在小智服务中输入绑定 ID", "Enter the binding ID in Xiaozhi", "XiaozhiサービスでバインドIDを入力してください"),
UI_CATALOG("已打斷", "已打断", "Interrupted", "中断しました"),
UI_CATALOG("請開始說話", "请开始说话", "Please start speaking", "話し始めてください"),
UI_CATALOG("請繼續說話", "请继续说话", "Please continue speaking", "話し続けてください"),
UI_CATALOG("天氣城市已設定", "天气城市已设置", "Weather city set", "天気都市を設定しました"),
UI_CATALOG("天氣城市已儲存", "天气城市已保存", "Weather city saved", "天気都市を保存しました"),
UI_CATALOG("正在背景更新全部天氣", "正在后台更新全部天气", "Updating all weather in the background", "天気情報をバックグラウンドで更新中"),
UI_CATALOG("沒有聽完整", "没有听完整", "I did not hear that completely", "完全には聞き取れませんでした"),
UI_CATALOG("請繼續說，或重新說一遍", "请继续说，或重新说一遍", "Please continue or say it again", "続けて話すか、もう一度話してください"),
UI_CATALOG("連線失敗，正在重試", "连接失败，正在重试", "Connection failed; retrying", "接続に失敗しました。再試行中"),
UI_CATALOG("系統忙碌，稍後重試", "系统繁忙，稍后重试", "System busy; try again later", "システムが混雑しています。後でもう一度お試しください"),
UI_CATALOG("音訊狀態異常，正在重試", "音频状态异常，正在重试", "Audio state error; retrying", "オーディオ状態異常。再試行中"),
UI_CATALOG("已喚醒", "已唤醒", "Awake", "起動しました"),
UI_CATALOG("正在連接語音會話", "正在连接语音会话", "Connecting to voice session", "音声セッションに接続中"),
UI_CATALOG("小智正在說話", "小智正在说话", "Xiaozhi is speaking", "Xiaozhiが話しています"),
UI_CATALOG("直接說話即可打斷", "直接说话即可打断", "Speak directly to interrupt", "そのまま話して中断できます"),
UI_CATALOG("語音會話中斷，稍後重試", "语音会话中断，稍后重试", "Voice session interrupted; retrying later", "音声セッションが中断されました。後で再試行します"),
UI_CATALOG("小智任務啟動失敗", "小智任务启动失败", "Failed to start Xiaozhi task", "Xiaozhiタスクの起動に失敗しました"),
UI_CATALOG("已啟用離線模式", "已启用离线模式", "Offline mode enabled", "オフラインモードを有効にしました"),
UI_CATALOG("日期時間格式無效", "日期时间格式无效", "Invalid date and time format", "日付と時刻の形式が無効です"),
UI_CATALOG("提交內容過長，請縮短自訂欄位後重試。", "提交内容过长，请缩短自定义字段后重试。", "Request is too large. Shorten the custom fields and try again.", "送信内容が長すぎます。カスタム項目を短くして再試行してください。"),
UI_CATALOG("缺少請求參數。", "缺少请求参数。", "Missing request parameter.", "リクエストパラメーターがありません。"),
UI_CATALOG("裝置記憶體不足，請稍後重試。", "设备内存不足，请稍后重试。", "Device memory is low. Please try again later.", "デバイスのメモリ不足です。後でもう一度お試しください。"),
UI_CATALOG("網路連線成功", "网络连接成功", "Wi-Fi connected", "ネットワーク接続成功"),
UI_CATALOG("正在驗證網路設定", "正在验证网络配置", "Validating network settings", "ネットワーク設定を確認中"),
UI_CATALOG("設定資訊不完整", "配置信息不完整", "Incomplete setup information", "設定情報が不足しています"),
UI_CATALOG("Wi-Fi 連線失敗", "Wi-Fi 连接失败", "Wi-Fi connection failed", "Wi-Fi接続失敗"),
UI_CATALOG("天氣服務驗證失敗", "天气服务验证失败", "Weather service validation failed", "天気サービスの確認失敗"),
UI_CATALOG("天氣城市無效", "天气城市无效", "Invalid weather city", "天気の都市が無効です"),
UI_CATALOG("Wi-Fi 與 NTP 設定已儲存，裝置將返回本機時鐘介面。", "Wi-Fi 与 NTP 设置已保存，设备将返回本地时钟界面。", "Wi-Fi and NTP settings saved. Returning to the local clock.", "Wi-FiとNTPの設定を保存しました。ローカル時計画面に戻ります。"),
UI_CATALOG("裝置正在連接 Wi-Fi，請稍候。", "设备正在连接 Wi-Fi，请稍候。", "The device is connecting to Wi-Fi. Please wait.", "デバイスがWi-Fiに接続中です。しばらくお待ちください。"),
UI_CATALOG("請填寫 Wi-Fi 名稱；NTP 伺服器可保留預設值 pool.ntp.org。", "请填写 Wi-Fi 名称；NTP 服务器可保留默认值 pool.ntp.org。", "Enter a Wi-Fi name; the NTP server can keep the default pool.ntp.org.", "Wi-Fi名を入力してください。NTPサーバーは既定値 pool.ntp.org のまま使用できます。"),
UI_CATALOG("裝置無法連線主要 Wi-Fi 或備用 Wi-Fi。請檢查密碼、訊號和路由器狀態後重新填寫。", "设备未能连接主 Wi-Fi 或备用 Wi-Fi。请检查密码、信号和路由器状态后重新填写。", "The device could not connect to primary or backup Wi-Fi. Check the password, signal, and router.", "デバイスが主Wi-Fiまたは予備Wi-Fiに接続できませんでした。パスワード、信号、ルーターの状態を確認して再入力してください。"),
UI_CATALOG("Wi-Fi 已連線，但 Open-Meteo 服務暫時無法存取，請稍後重試。", "Wi-Fi 已连接，但 Open-Meteo 服务暂时无法访问，请稍后重试。", "Wi-Fi is connected, but the Open-Meteo service is temporarily unavailable. Try again later.", "Wi-Fiには接続しましたが、Open-Meteoサービスを一時的に利用できません。後でもう一度お試しください。"),
UI_CATALOG("Open-Meteo 無法辨識該城市。請修改城市，或留空使用自動定位。", "Open-Meteo 无法识别该城市。请修改城市，或留空使用自动定位。", "Open-Meteo could not identify the city. Edit the city or leave it blank for automatic location.", "Open-Meteoで都市を認識できませんでした。都市を修正するか、空欄にして自動位置情報を使用してください。"),
UI_CATALOG("Wi-Fi 正在掃描，請稍後重新整理頁面。", "Wi-Fi 正在扫描，请稍后刷新页面。", "Wi-Fi is scanning. Refresh the page shortly.", "Wi-Fiをスキャン中です。しばらくしてページを更新してください。"),
UI_CATALOG("Wi-Fi 掃描失敗，請重新整理頁面後重試。", "Wi-Fi 扫描失败，请刷新页面重试。", "Wi-Fi scan failed. Refresh the page and try again.", "Wi-Fiのスキャンに失敗しました。ページを更新して再試行してください。"),
UI_CATALOG("找不到可用的 Wi-Fi 網路。", "没有发现可用的 Wi-Fi 网络。", "No available Wi-Fi networks were found.", "利用可能なWi-Fiネットワークが見つかりません。"),
UI_CATALOG("裝置記憶體不足，暫時無法顯示 Wi-Fi 清單。", "设备内存不足，暂时无法显示 Wi-Fi 列表。", "Device memory is low; the Wi-Fi list cannot be displayed.", "メモリ不足のためWi-Fi一覧を表示できません。"),
UI_CATALOG("附近的 Wi-Fi（點選填入主要 Wi-Fi）", "附近的 Wi-Fi（点击填入主 Wi-Fi）", "Nearby Wi-Fi (click to fill primary Wi-Fi)", "近くのWi-Fi（クリックして主Wi-Fiに入力）"),
UI_CATALOG("重新掃描", "重新扫描", "Scan again", "再スキャン"),
UI_CATALOG("時鐘設定模式", "时钟设置模式", "Clock setup mode", "時計設定モード"),
UI_CATALOG("Wi-Fi 與 NTP 校時設定", "Wi-Fi 与 NTP 校时设置", "Wi-Fi and NTP time synchronization", "Wi-FiとNTPの時刻同期設定"),
UI_CATALOG("裝置熱點", "设备热点", "Device hotspot", "デバイスのアクセスポイント"),
UI_CATALOG("已連線", "已连接", "Connected", "接続済み"),
UI_CATALOG("驗證中", "验证中", "Validating", "確認中"),
UI_CATALOG("失敗", "失败", "Failed", "失敗"),
UI_CATALOG("：", "：", ": ", "："),
UI_CATALOG("時鐘設定結果", "时钟设置结果", "Clock setup result", "時計設定結果"),
UI_CATALOG("主要 Wi-Fi", "主 Wi-Fi", "Primary Wi-Fi", "主 Wi-Fi"),
UI_CATALOG("備用 Wi-Fi", "备用 Wi-Fi", "Backup Wi-Fi", "予備 Wi-Fi"),
UI_CATALOG("未設定", "未配置", "Not configured", "未設定"),
UI_CATALOG("NTP 伺服器", "NTP 服务器", "NTP server", "NTPサーバー"),
UI_CATALOG("最近一次 Wi-Fi 斷線原因", "最近一次 Wi-Fi 断线原因", "Last Wi-Fi disconnect reason", "直近のWi-Fi切断理由"),
UI_CATALOG("返回設定頁", "返回设置页", "Back to setup", "設定に戻る"),
UI_CATALOG("設定成功", "设置成功", "Setup complete", "設定成功"),
UI_CATALOG("裝置即將返回本機時鐘介面。", "设备即将返回本地时钟界面。", "The device will return to the local clock interface.", "デバイスはローカル時計画面に戻ります。"),
UI_CATALOG("正在儲存，請稍候…", "正在保存，请稍候…", "Saving, please wait…", "保存中です。お待ちください…"),
UI_CATALOG("Wi-Fi 設定", "Wi-Fi 设置", "Wi-Fi Settings", "Wi-Fi設定"),
UI_CATALOG("僅在校時或設定期間啟用網路", "仅在校时或设置期间启用网络", "Network is enabled for time sync and setup", "時刻同期または設定中のみネットワークを使用します"),
UI_CATALOG("主要 Wi-Fi 名稱（SSID）", "主 Wi-Fi 名称（SSID）", "Primary Wi-Fi (SSID)", "主 Wi-Fi 名（SSID）"),
UI_CATALOG("請選擇或輸入 Wi-Fi 名稱", "请选择或输入 Wi-Fi 名称", "Select or enter a Wi-Fi name", "Wi-Fi名を選択または入力"),
UI_CATALOG("主要 Wi-Fi 密碼", "主 Wi-Fi 密码", "Primary Wi-Fi password", "主 Wi-Fi パスワード"),
UI_CATALOG("請輸入 Wi-Fi 密碼", "请输入 Wi-Fi 密码", "Enter the Wi-Fi password", "Wi-Fiパスワードを入力"),
UI_CATALOG("SSID 未變更時，密碼留空可繼續使用原密碼。", "SSID 未改变时，密码留空可继续使用原密码。", "When the SSID is unchanged, leave the password blank to keep using the current password.", "SSIDを変更しない場合は、パスワードを空欄にすると現在のパスワードを使用します。"),
UI_CATALOG("備用 Wi-Fi 名稱", "备用 Wi-Fi 名称", "Backup Wi-Fi", "予備 Wi-Fi 名"),
UI_CATALOG("選填", "选填", "Optional", "任意"),
UI_CATALOG("主要 Wi-Fi 無法使用時自動嘗試", "主 Wi-Fi 不可用时自动尝试", "Try automatically if primary Wi-Fi is unavailable", "主 Wi-Fi が使えない場合に自動で試行"),
UI_CATALOG("備用 Wi-Fi 密碼", "备用 Wi-Fi 密码", "Backup Wi-Fi password", "予備 Wi-Fi パスワード"),
UI_CATALOG("請輸入備用 Wi-Fi 密碼", "请输入备用 Wi-Fi 密码", "Enter the backup Wi-Fi password", "予備 Wi-Fi のパスワードを入力"),
UI_CATALOG("可不設定；備用連線成功後會自動成為首選 Wi-Fi。", "可不配置；备用连接成功后会自动成为首选 Wi-Fi。", "Optional; after a successful backup connection, it becomes the preferred Wi-Fi.", "設定しなくても構いません。予備接続に成功すると優先 Wi-Fi になります。"),
UI_CATALOG("時間同步", "时间同步", "Time sync", "時刻同期"),
UI_CATALOG("開機及每 24 小時自動校時", "开机及每 24 小时自动校时", "Automatic sync at boot and every 24 hours", "起動時と24時間ごとに自動で時刻を合わせます"),
UI_CATALOG("pool.ntp.org", "pool.ntp.org", "pool.ntp.org", "pool.ntp.org"),
UI_CATALOG("請填主機名稱，例如 pool.ntp.org；不要包含 http://、https:// 或路徑。", "请填写主机名，例如 pool.ntp.org；不要包含 http://、https:// 或路径。", "Enter a host name such as pool.ntp.org; do not include http://, https://, or a path.", "pool.ntp.org のようなホスト名を入力してください。http://、https://、パスは含めないでください。"),
UI_CATALOG("天氣城市", "天气城市", "Weather city", "天気の都市"),
UI_CATALOG("留空時依 IP 自動定位", "留空时依 IP 自动定位", "Leave blank to locate by IP", "空欄の場合はIPで自動検出"),
UI_CATALOG("使用 Open-Meteo 全球城市搜尋，不需要 API Key。", "使用 Open-Meteo 全球城市搜索，不需要 API Key。", "Uses the global Open-Meteo city search; no API key is required.", "APIキー不要のOpen-Meteo全球都市検索を使用します。"),
UI_CATALOG("儲存並連線", "保存并连接", "Save and connect", "保存して接続"),
UI_CATALOG("正在儲存設定並連線，請稍候…", "正在保存设置并连接，请稍候…", "Saving settings and connecting, please wait…", "設定を保存して接続中です。お待ちください…"),
UI_CATALOG("離線模式", "离线模式", "Offline mode", "オフラインモード"),
UI_CATALOG("不連接 Wi-Fi，使用手動時間與 RTC", "不连接 Wi-Fi，使用手动时间与 RTC", "Use manual time and RTC without Wi-Fi", "Wi-Fiに接続せず手動時刻とRTCを使用します"),
UI_CATALOG("本機日期時間", "本地日期时间", "Local date and time", "ローカル日時"),
UI_CATALOG("以離線模式啟動", "以离线模式启动", "Start offline mode", "オフラインモードで起動"),
UI_CATALOG("時間同步逾時", "时间同步超时", "Time sync timed out", "時刻同期がタイムアウトしました"),
UI_CATALOG("天氣同步逾時", "天气同步超时", "Weather sync timed out", "天気同期がタイムアウトしました"),
UI_CATALOG("一言更新逾時", "一言更新超时", "Saying update timed out", "一言の更新がタイムアウトしました"),
UI_CATALOG("--:--", "--:--", "--:--", "--:--"),
UI_CATALOG("%02d:%02d", "%02d:%02d", "%02d:%02d", "%02d:%02d"),
UI_CATALOG("--/--", "--/--", "--/--", "--/--"),
UI_CATALOG("--/--°C", "--/--°C", "--/--°C", "--/--°C"),
UI_CATALOG("--:--", "--:--", "--:--", "--:--"),
UI_CATALOG("--°C", "--°C", "--°C", "--°C"),
UI_CATALOG("--°C --%", "--°C --%", "--°C --%", "--°C --%"),
UI_CATALOG("%.0f°C %.0f%%", "%.0f°C %.0f%%", "%.0f°C %.0f%%", "%.0f°C %.0f%%"),
UI_CATALOG("--°C --%%", "--°C --%%", "--°C --%%", "--°C --%%"),
UI_CATALOG("--.-°C", "--.-°C", "--.-°C", "--.-°C"),
UI_CATALOG("--.-%%", "--.-%%", "--.-%%", "--.-%%"),
UI_CATALOG("%.1f°C", "%.1f°C", "%.1f°C", "%.1f°C"),
UI_CATALOG("%.1f%%", "%.1f%%", "%.1f%%", "%.1f%%"),
UI_CATALOG("星期日", "星期日", "Sun", "日曜"),
UI_CATALOG("星期一", "星期一", "Mon", "月曜"),
UI_CATALOG("星期二", "星期二", "Tue", "火曜"),
UI_CATALOG("星期三", "星期三", "Wed", "水曜"),
UI_CATALOG("星期四", "星期四", "Thu", "木曜"),
UI_CATALOG("星期五", "星期五", "Fri", "金曜"),
UI_CATALOG("星期六", "星期六", "Sat", "土曜"),
UI_CATALOG("新版本 ", "新版本 ", "New version ", "新バージョン "),
UI_CATALOG("BOOT：檢查更新", "BOOT：检查更新", "BOOT: Checking for updates", "BOOT：更新を確認中"),
UI_CATALOG("未設定 Wi-Fi", "未配置 Wi-Fi", "Wi-Fi not configured", "Wi-Fi未設定"),
UI_CATALOG("時間同步完成", "时间同步完成", "Time sync complete", "時刻同期完了"),
UI_CATALOG("天氣同步完成", "天气同步完成", "Weather sync complete", "天気同期完了"),
UI_CATALOG("一言更新完成", "一言更新完成", "Saying update complete", "一言更新完了"),
UI_CATALOG("網路檢測完成", "网络检测完成", "Network check complete", "ネットワーク診断完了"),
UI_CATALOG("時間同步失敗", "时间同步失败", "Time sync failed", "時刻同期失敗"),
UI_CATALOG("天氣同步失敗", "天气同步失败", "Weather sync failed", "天気同期失敗"),
UI_CATALOG("一言更新失敗", "一言更新失败", "Saying update failed", "一言更新失敗"),
UI_CATALOG("網路檢測已取消", "网络检测已取消", "Network check canceled", "ネットワーク診断をキャンセルしました"),
UI_CATALOG("天氣同步不可用", "天气同步不可用", "Weather sync unavailable", "天気同期を利用できません"),
UI_CATALOG("元旦", "元旦", "New Yr", "元旦"),
UI_CATALOG("情人節", "情人节", "V-Day", "Vデー"),
UI_CATALOG("婦女", "妇女", "W-Day", "女性"),
UI_CATALOG("勞動", "劳动", "Labour", "労働"),
UI_CATALOG("兒童", "儿童", "Kids", "こども"),
UI_CATALOG("教師", "教师", "Teach.", "教師"),
UI_CATALOG("國慶", "国庆", "Nation", "建国"),
UI_CATALOG("聖誕", "圣诞", "Xmas", "Xmas"),
UI_CATALOG("春節", "春节", "Spring", "春節"),
UI_CATALOG("元宵", "元宵", "Lantern", "元宵"),
UI_CATALOG("端午", "端午", "Dragon", "端午"),
UI_CATALOG("七夕", "七夕", "Qixi", "七夕"),
UI_CATALOG("中秋", "中秋", "M-Aut.", "中秋"),
UI_CATALOG("重陽", "重阳", "Ninth", "重陽"),
UI_CATALOG("臘八", "腊八", "Laba", "臘八"),
UI_CATALOG("小寒", "小寒", "Minor", "小寒"),
UI_CATALOG("大寒", "大寒", "Major", "大寒"),
UI_CATALOG("立春", "立春", "Spring", "立春"),
UI_CATALOG("雨水", "雨水", "Rain", "雨水"),
UI_CATALOG("驚蟄", "惊蛰", "Insects", "啓蟄"),
UI_CATALOG("春分", "春分", "Eqx.", "春分"),
UI_CATALOG("清明", "清明", "Bright", "清明"),
UI_CATALOG("穀雨", "谷雨", "Rain", "穀雨"),
UI_CATALOG("立夏", "立夏", "Sum.", "立夏"),
UI_CATALOG("小滿", "小满", "Grain", "小満"),
UI_CATALOG("芒種", "芒种", "Grain", "芒種"),
UI_CATALOG("夏至", "夏至", "Sum.", "夏至"),
UI_CATALOG("小暑", "小暑", "Minor", "小暑"),
UI_CATALOG("大暑", "大暑", "Major", "大暑"),
UI_CATALOG("立秋", "立秋", "Fall", "立秋"),
UI_CATALOG("處暑", "处暑", "Heat", "処暑"),
UI_CATALOG("白露", "白露", "Dew", "白露"),
UI_CATALOG("秋分", "秋分", "Eqx.", "秋分"),
UI_CATALOG("寒露", "寒露", "Dew", "寒露"),
UI_CATALOG("霜降", "霜降", "Frost", "霜降"),
UI_CATALOG("立冬", "立冬", "Winter", "立冬"),
UI_CATALOG("小雪", "小雪", "Snow", "小雪"),
UI_CATALOG("大雪", "大雪", "Snow", "大雪"),
UI_CATALOG("冬至", "冬至", "Winter", "冬至"),
UI_CATALOG("%02d:00", "%02d:00", "%02d:00", "%02d:00"),
UI_CATALOG("--", "--", "--", "--"),
UI_CATALOG("%.0f°C", "%.0f°C", "%.0f°C", "%.0f°C"),
UI_CATALOG("%.0f%%", "%.0f%%", "%.0f%%", "%.0f%%"),
UI_CATALOG("%.1f", "%.1f", "%.1f", "%.1f"),
UI_CATALOG("%.0f", "%.0f", "%.0f", "%.0f"),
UI_CATALOG("%s\n%s", "%s\n%s", "%s\n%s", "%s\n%s"),
UI_CATALOG("%s/%s°C", "%s/%s°C", "%s/%s°C", "%s/%s°C"),
UI_CATALOG("%s°C", "%s°C", "%s°C", "%s°C"),
UI_CATALOG("%s%s", "%s%s", "%s%s", "%s%s"),
UI_CATALOG("%d月", "%d月", "Lunar month %d", "%d月"),
UI_CATALOG("閏%d月", "闰%d月", "Leap lunar month %d", "う%d月"),
UI_CATALOG("%d日", "%d日", "Lunar day %d", "%d日"),
UI_CATALOG("閏農曆月份 %d", "闰农历月份 %d", "Leap lunar month %d", "うるう月%d"),
UI_CATALOG("初一", "初一", "Day 1", "1日"),
UI_CATALOG("初二", "初二", "Day 2", "2日"),
UI_CATALOG("初三", "初三", "Day 3", "3日"),
UI_CATALOG("初四", "初四", "Day 4", "4日"),
UI_CATALOG("初五", "初五", "Day 5", "5日"),
UI_CATALOG("初六", "初六", "Day 6", "6日"),
UI_CATALOG("初七", "初七", "Day 7", "7日"),
UI_CATALOG("初八", "初八", "Day 8", "8日"),
UI_CATALOG("初九", "初九", "Day 9", "9日"),
UI_CATALOG("初十", "初十", "Day 10", "10日"),
UI_CATALOG("十一", "十一", "Day 11", "11日"),
UI_CATALOG("十二", "十二", "Day 12", "12日"),
UI_CATALOG("十三", "十三", "Day 13", "13日"),
UI_CATALOG("十四", "十四", "Day 14", "14日"),
UI_CATALOG("十五", "十五", "Day 15", "15日"),
UI_CATALOG("十六", "十六", "Day 16", "16日"),
UI_CATALOG("十七", "十七", "Day 17", "17日"),
UI_CATALOG("十八", "十八", "Day 18", "18日"),
UI_CATALOG("十九", "十九", "Day 19", "19日"),
UI_CATALOG("二十", "二十", "Day 20", "20日"),
UI_CATALOG("廿一", "廿一", "Day 21", "21日"),
UI_CATALOG("廿二", "廿二", "Day 22", "22日"),
UI_CATALOG("廿三", "廿三", "Day 23", "23日"),
UI_CATALOG("廿四", "廿四", "Day 24", "24日"),
UI_CATALOG("廿五", "廿五", "Day 25", "25日"),
UI_CATALOG("廿六", "廿六", "Day 26", "26日"),
UI_CATALOG("廿七", "廿七", "Day 27", "27日"),
UI_CATALOG("廿八", "廿八", "Day 28", "28日"),
UI_CATALOG("廿九", "廿九", "Day 29", "29日"),
UI_CATALOG("三十", "三十", "Day 30", "30日"),
UI_CATALOG("正月", "正月", "Month 1", "1月"),
UI_CATALOG("二月", "二月", "Month 2", "2月"),
UI_CATALOG("三月", "三月", "Month 3", "3月"),
UI_CATALOG("四月", "四月", "Month 4", "4月"),
UI_CATALOG("五月", "五月", "Month 5", "5月"),
UI_CATALOG("六月", "六月", "Month 6", "6月"),
UI_CATALOG("七月", "七月", "Month 7", "7月"),
UI_CATALOG("八月", "八月", "Month 8", "8月"),
UI_CATALOG("九月", "九月", "Month 9", "9月"),
UI_CATALOG("十月", "十月", "Month 10", "10月"),
UI_CATALOG("冬月", "冬月", "Month 11", "11月"),
UI_CATALOG("臘月", "腊月", "Month 12", "12月"),
UI_CATALOG("%d %s", "%d %s", "%d %s", "%d %s"),
UI_CATALOG("%04d/%02d/%02d   %s", "%04d/%02d/%02d   %s", "%04d/%02d/%02d   %s", "%04d/%02d/%02d   %s"),
UI_CATALOG("--", "--", "--", "--"),
UI_CATALOG("--", "--", "--", "--"),
UI_CATALOG("--°C", "--°C", "--°C", "--°C"),
UI_CATALOG("--%", "--%", "--%", "--%"),
UI_CATALOG("%s°C", "%s°C", "%s°C", "%s°C"),
UI_CATALOG("%s%%", "%s%%", "%s%%", "%s%%"),
UI_CATALOG("--.-°C", "--.-°C", "--.-°C", "--.-°C"),
UI_CATALOG("--%", "--%", "--%", "--%"),
UI_CATALOG("--", "--", "--", "--"),
UI_CATALOG("%.1f°C", "%.1f°C", "%.1f°C", "%.1f°C"),
UI_CATALOG("%.0f%%", "%.0f%%", "%.0f%%", "%.0f%%"),
UI_CATALOG("%d", "%d", "%d", "%d"),
UI_CATALOG("--", "--", "--", "--"),
UI_CATALOG("--.-°C", "--.-°C", "--.-°C", "--.-°C"),
UI_CATALOG("--.-%", "--.-%", "--.-%", "--.-%"),
UI_CATALOG("%04d-%02d-%02d %02d:%02d:%02d", "%04d-%02d-%02d %02d:%02d:%02d", "%04d-%02d-%02d %02d:%02d:%02d", "%04d-%02d-%02d %02d:%02d:%02d"),
UI_CATALOG("%02d:%02d", "%02d:%02d", "%02d:%02d", "%02d:%02d"),
UI_CATALOG("繁體", "繁体", "T-Chinese", "中国語"),
UI_CATALOG("簡體", "简体", "S-Chinese", "簡体"),
UI_CATALOG("英文", "英文", "English", "英語"),
UI_CATALOG("日文", "日语", "Japanese", "日本語"),
